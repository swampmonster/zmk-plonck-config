## boards/arm/plonck/Kconfig.board
```kconfig
# plonck board configuration

# Copyright (c) 2021 swampmonster
# SPDX-License-Identifier: MIT

config BOARD_PLONCK_B0
	bool "plonck rev b0"
	depends on SOC_NRF52840_QIAA
```

## boards/arm/plonck/Kconfig.defconfig
```kconfig
# Copyright (c) 2021 swampmonster
# SPDX-License-Identifier: MIT

if BOARD_PLONCK_B0

config BOARD
	default "plonck rev b0"

config ZMK_KEYBOARD_NAME
    default "plonck_rev_b0"

if USB

config USB_NRFX
	default y

config USB_DEVICE_STACK
	default y

endif # USB

config BT_CTLR
	default BT

config ZMK_BLE
	default y

config ZMK_USB
	default y
	
config ZMK_BATTERY_VOLTAGE_DIVIDER
	default y

endif # BOARD_PLONCK_B0
```
